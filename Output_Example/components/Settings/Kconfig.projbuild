## Output_Example/components/Settings/Kconfig.projbuild
```kconfig
menu "SETTINGS API"
			
	config SETTINGS_DEBUG
	bool "Debug output"
	default 1
	
	config SETTINGS_DEBUG_TAG
	string "Debug Tag"
	default "SETTINGS API"
	
	config SETTINGS_NAMESPACE
	string "Namespace"
	default "storage"
	
endmenu
```

## Output_Example/sdkconfig.defaults
```kconfig
#
#
#
# Bootloader config
#
CONFIG_BOOTLOADER_SPI_WP_PIN=7
# Serial flasher config
#
CONFIG_ESPTOOLPY_FLASHMODE_QIO=y
CONFIG_ESPTOOLPY_FLASHSIZE_4MB=y
CONFIG_ESPTOOLPY_FLASHSIZE="4MB"
# Partition Table
#
CONFIG_PARTITION_TABLE_CUSTOM=y
CONFIG_PARTITION_TABLE_CUSTOM_FILENAME="partitions_example.csv"
CONFIG_PARTITION_TABLE_FILENAME="partitions_example.csv"
#
# FreeRTOS
#
CONFIG_FREERTOS_HZ=200
CONFIG_FLASHMODE_QIO=y
```
